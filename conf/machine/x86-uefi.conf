## conf/machine/x86-uefi.conf
```bitbake
#
# CIP Core, generic profile
#
# Copyright (c) Siemens AG, 2019-2026
#
# SPDX-License-Identifier: MIT
#

DISTRO_ARCH = "amd64"

IMAGE_FSTYPES ?= "wic"
X86_UEFI_DEFAULT_WKS ?= "x86_64-generic.wks"
WKS_FILE ?= "${X86_UEFI_DEFAULT_WKS}"
IMAGER_INSTALL:wic += "${SYSTEMD_BOOTLOADER_INSTALL}"
USE_CIP_KERNEL_CONFIG = "1"

PREFERRED_PROVIDER_factory-reset-helper = "factory-reset-helper-efi"
```
